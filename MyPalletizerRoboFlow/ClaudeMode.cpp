#include "ClaudeMode.h"
#include <M5Stack.h>
#include <BLEDevice.h>
#include <BLEUtils.h>
#include <BLEServer.h>

#ifdef header
#undef header
#endif
#include <ArduinoJson.h>

#define CLAUDE_SERVICE_UUID "4c41555a-4465-7669-6365-000000000001"
#define CLAUDE_RX_CHAR_UUID "4c41555a-4465-7669-6365-000000000002"

// Anthropic design palette (RGB565)
// bg:      #000000  panel: #1f1f1e  text: #faf9f5  dim: #b0aea5
// accent:  #d97757  green: #788c5d  amber: #d97757  red: #c0392b
// bar_bg:  #2a2a28
#define COL_BG       0x0000
#define COL_PANEL    0x18E3  // #1f1f1e
#define COL_TEXT     0xFFF5  // #faf9f5 warm off-white
#define COL_DIM      0xB574  // #b0aea5
#define COL_BAR_BG   0x2945  // #2a2a28
#define COL_GREEN    0x7C6B  // #788c5d muted sage
#define COL_AMBER    0xDBAB  // #d97757 terra-cotta
#define COL_RED      0xC165  // #c0392b
#define COL_ACCENT   0xDBAB  // #d97757 terra-cotta

// Layout (320x240)
#define MARGIN       8
#define PANEL_X      MARGIN
#define PANEL_W      (320 - 2 * MARGIN)  // 304
#define PANEL_H      75
#define PANEL_R      6
#define PANEL_PAD    8
#define BAR_H        12
#define BAR_R        6
#define PANEL1_Y     36
#define PANEL2_Y     (PANEL1_Y + PANEL_H + 8)  // 119

// Splash animation
#define GRID_SIZE    20
#define CELL_SIZE    12
#define SPLASH_X     40
#define SPLASH_Y     0

static const uint16_t anim_palette[10] = {0x0000, 0xCBED, 0x0861, 0x0000, 0x0000, 0x0000, 0x0000, 0x0000, 0x0000, 0x0000};
static const uint16_t anim_holds[16] = {500,200,280,80,360,200,320,80,700,200,300,500,200,80,80,340};
static const uint8_t PROGMEM anim_frames[16][400] = {
    {0,0,0,0,0,0,0,0,0,0,0,0,0,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0,0},
    {0,0,0,0,0,0,0,0,0,0,0,0,0,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0,0},
    {0,0,0,0,0,0,0,0,0,0,0,0,0,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0,0},
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    {0,0,0,0,0,0,0,0,0,0,0,0,0,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0,0},
};
#define ANIM_FRAME_COUNT 16

//                          J1        J2      J3     J4     speed
//                       -160~160   0~90    0~60    inf
static const float anim_poses[ANIM_FRAME_COUNT][5] = {
    {   0,  45,  30,    0,  40},  // 0  center neutral
    {  15,  50,  25,   20,  35},  // 1  lean right, nod
    {  30,  55,  20,   40,  35},  // 2  more right
    {  40,  60,  15,   60,  30},  // 3  right peak
    {  30,  55,  20,   80,  35},  // 4  coming back
    {  15,  50,  30,  100,  35},  // 5  almost center
    {   0,  40,  40,  120,  40},  // 6  center, raised
    { -10,  35,  45,  140,  35},  // 7  start left
    { -25,  40,  40,  160,  35},  // 8  going left
    { -40,  50,  30,  180,  30},  // 9  left peak
    { -35,  55,  25,  160,  35},  // 10 coming back
    { -20,  50,  30,  140,  35},  // 11 almost center
    { -10,  45,  35,  110,  40},  // 12 center
    {   0,  40,  40,   80,  40},  // 13 center, raised
    {   5,  45,  35,   40,  35},  // 14 settling
    {   0,  45,  30,   10,  35},  // 15 back to start
};

// Animation 1: Dance Bounce
static const uint16_t anim1_holds[ANIM_FRAME_COUNT] = {100,80,140,100,60,80,120,80,100,80,160,80,60,80,120,100};
static const uint8_t PROGMEM anim1_frames[ANIM_FRAME_COUNT][400] = {
    {0,0,0,0,0,0,0,0,0,0,0,0,0,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0,0},
    {0,0,0,0,0,0,0,0,0,0,0,0,0,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0,0},
    {0,0,0,0,0,0,0,0,0,0,0,0,0,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0,0},
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    {0,0,0,0,0,0,0,0,0,0,0,0,0,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0,0},
};
static const float anim1_poses[ANIM_FRAME_COUNT][5] = {
    {   0,  50,  25,    0,  50},
    {  10,  55,  20,   30,  50},
    {  30,  65,  10,   60,  60},
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    { -10,  55,  20,  -30,  50},
};

#define ANIM_COUNT 2
static uint8_t current_anim = 0;
static const uint16_t *cur_holds = anim_holds;
static const uint8_t (*cur_frames)[400] = anim_frames;
static const float (*cur_poses)[5] = anim_poses;

static void set_animation(uint8_t idx) {
    current_anim = idx % ANIM_COUNT;
    if (current_anim == 0) {
        cur_holds = anim_holds; cur_frames = anim_frames; cur_poses = anim_poses;
    } else {
        cur_holds = anim1_holds; cur_frames = anim1_frames; cur_poses = anim1_poses;
    }
}

static struct {
    int session_pct;
    int session_reset_min;
    int weekly_pct;
    int weekly_reset_min;
    char status[16];
    bool ok;
    bool updated;
} usage_data = {0, 0, 0, 0, "unknown", false, false};

static bool ble_connected = false;
static bool show_splash = true;

class ClaudeServerCallbacks : public BLEServerCallbacks {
    void onConnect(BLEServer* pServer) { ble_connected = true; }
    void onDisconnect(BLEServer* pServer) { ble_connected = false; }
};

class ClaudeBLECallbacks : public BLECharacteristicCallbacks {
    void onWrite(BLECharacteristic *pCharacteristic) {
        std::string value = pCharacteristic->getValue();
        if (value.length() > 0) {
            JsonDocument doc;
            DeserializationError error = deserializeJson(doc, value);
            if (!error && (doc["ok"] | false)) {
                usage_data.session_pct = doc["s"] | 0;
                usage_data.session_reset_min = doc["sr"] | 0;
                usage_data.weekly_pct = doc["w"] | 0;
                usage_data.weekly_reset_min = doc["wr"] | 0;
                const char* st = doc["st"] | "unknown";
                strncpy(usage_data.status, st, sizeof(usage_data.status) - 1);
                usage_data.ok = true;
                usage_data.updated = true;
            }
        }
    }
};

static uint16_t pct_color(int pct) {
    if (pct < 60) return COL_GREEN;
    if (pct < 80) return COL_AMBER;
    return COL_RED;
}

static void drawPanel(int x, int y, int w, int h) {
    M5.Lcd.fillRoundRect(x, y, w, h, PANEL_R, COL_PANEL);
}

static void drawBar(int x, int y, int w, int h, int pct, uint16_t color) {
    M5.Lcd.fillRoundRect(x, y, w, h, BAR_R, COL_BAR_BG);
    if (pct > 0) {
        int fill_w = (w * pct) / 100;
        if (fill_w < h) fill_w = h;
        if (fill_w > w) fill_w = w;
        M5.Lcd.fillRoundRect(x, y, fill_w, h, BAR_R, color);
    }
}

static void drawPill(int x, int y, const char* text) {
    int tw = strlen(text) * 6;
    int pw = tw + 12;
    int ph = 15;
    M5.Lcd.fillRoundRect(x, y, pw, ph, 7, COL_BAR_BG);
    M5.Lcd.setTextSize(1);
    M5.Lcd.setTextColor(COL_TEXT, COL_BAR_BG);
    M5.Lcd.setCursor(x + 6, y + 4);
    M5.Lcd.print(text);
}

static void drawResetTime(int x, int y, int minutes) {
    M5.Lcd.setTextSize(1);
    M5.Lcd.setTextColor(COL_DIM, COL_PANEL);
    M5.Lcd.setCursor(x, y);
    if (minutes <= 0) {
        M5.Lcd.print("resetting...    ");
    } else if (minutes < 60) {
        M5.Lcd.printf("resets in %dm    ", minutes);
    } else {
        int h = minutes / 60;
        int m = minutes % 60;
        M5.Lcd.printf("resets in %dh%dm  ", h, m);
    }
}

void ClaudeMode::run(MyPalletizerBasic &myCobot) {
    EXIT = false;
    usage_data.updated = false;
    usage_data.ok = false;
    ble_connected = false;
    show_splash = true;
    current_frame = 0;
    last_frame_ms = 0;

    SoundUtil::init();

    static bool ble_inited = false;
    static BLEServer *pServer = nullptr;
    if (!ble_inited) {
        BLEDevice::init("Claude MyPal");
        pServer = BLEDevice::createServer();
        pServer->setCallbacks(new ClaudeServerCallbacks());
        BLEService *pService = pServer->createService(CLAUDE_SERVICE_UUID);
        BLECharacteristic *pRxChar = pService->createCharacteristic(
            CLAUDE_RX_CHAR_UUID, BLECharacteristic::PROPERTY_WRITE);
        pRxChar->setCallbacks(new ClaudeBLECallbacks());
        pService->start();
        ble_inited = true;
    }
    pServer->getAdvertising()->start();

    SoundUtil::play("/claude/kirov-reporting.wav");

    set_animation(0);
    const float *p0 = cur_poses[0];
    MyPalletizerAngles home = {p0[0], p0[1], p0[2], p0[3]};
    myCobot.writeAngles(home, (int)p0[4]);

    M5.Lcd.clear(COL_BG);
    drawSplash();

    while (!EXIT) {
        M5.update();

        if (M5.BtnA.wasReleased()) {
            show_splash = !show_splash;
            M5.Lcd.clear(COL_BG);
            if (show_splash) {
                current_frame = 0;
                drawSplash();
            } else {
                drawUsageScreen();
            }
        }

        if (M5.BtnB.wasReleased()) {
            Serial.printf("BtnB pressed, show_splash=%d, current_anim=%d\n", show_splash, current_anim);
            if (show_splash) {
                set_animation(current_anim + 1);
                current_frame = 0;
                last_frame_ms = 0;
                M5.Lcd.clear(COL_BG);
                drawSplash();
                M5.Lcd.setTextSize(1);
                M5.Lcd.setTextColor(COL_DIM, COL_BG);
                M5.Lcd.setCursor(8, 228);
                M5.Lcd.print(current_anim == 0 ? "Idle Breathe" : "Dance Bounce");
                const float *pp = cur_poses[0];
                MyPalletizerAngles pose = {pp[0], pp[1], pp[2], pp[3]};
                myCobot.writeAngles(pose, (int)pp[4]);
            }
        }

        if (usage_data.updated) {
            usage_data.updated = false;
            static uint32_t last_sound_ms = 0;
            if (millis() - last_sound_ms > 5000) {
                last_sound_ms = millis();
                SoundUtil::play("/claude/acknowledged.wav");
                if (usage_data.session_pct >= 80) {
                    SoundUtil::play("/claude/mission-sir.wav");
                }
            }
            if (!show_splash) {
                drawUsageBars();
            }
        }

        if (show_splash) {
            uint16_t hold = cur_holds[current_frame];
            if (millis() - last_frame_ms >= hold) {
                current_frame = (current_frame + 1) % ANIM_FRAME_COUNT;
                drawSplash();
                last_frame_ms = millis();
                const float *p = cur_poses[current_frame];
                MyPalletizerAngles angles = {p[0], p[1], p[2], p[3]};
                myCobot.writeAngles(angles, (int)p[4]);
            }
        } else {
            drawStatusLine();
        }

        if (M5.BtnC.wasReleased()) {
            EXIT = true;
        }

        handleCommunication(myCobot);
        delay(20);
    }

    MyPalletizerAngles zero = {0, 0, 0, 0};
    myCobot.writeAngles(zero, 30);

    pServer->getAdvertising()->stop();
    M5.Lcd.clear(COL_BG);
}

void ClaudeMode::drawSplash() {
    const uint8_t *frame = cur_frames[current_frame];
    for (int gy = 0; gy < GRID_SIZE; gy++) {
        for (int gx = 0; gx < GRID_SIZE; gx++) {
            uint8_t idx = pgm_read_byte(&frame[gy * GRID_SIZE + gx]);
            uint16_t color = anim_palette[idx];
            M5.Lcd.fillRect(
                SPLASH_X + gx * CELL_SIZE,
                SPLASH_Y + gy * CELL_SIZE,
                CELL_SIZE, CELL_SIZE, color);
        }
    }
}

void ClaudeMode::drawUsageScreen() {
    // Title — "Usage" in warm off-white, left-aligned like Clawdmeter
    M5.Lcd.setTextColor(COL_TEXT, COL_BG);
    M5.Lcd.setTextSize(2);
    M5.Lcd.setCursor(MARGIN + 4, 10);
    M5.Lcd.print("Usage");

    // Panel 1: Current (session)
    drawPanel(PANEL_X, PANEL1_Y, PANEL_W, PANEL_H);

    // Big percentage top-left inside panel
    M5.Lcd.setTextSize(3);
    M5.Lcd.setTextColor(COL_TEXT, COL_PANEL);
    M5.Lcd.setCursor(PANEL_X + PANEL_PAD, PANEL1_Y + PANEL_PAD);
    M5.Lcd.print("---%");

    // "Current" pill top-right
    drawPill(PANEL_X + PANEL_W - 68, PANEL1_Y + PANEL_PAD + 2, "Current");

    // Bar
    int bar_x = PANEL_X + PANEL_PAD;
    int bar_w = PANEL_W - 2 * PANEL_PAD;
    int bar1_y = PANEL1_Y + 38;
    drawBar(bar_x, bar1_y, bar_w, BAR_H, 0, COL_GREEN);

    // Reset label
    M5.Lcd.setTextSize(1);
    M5.Lcd.setTextColor(COL_DIM, COL_PANEL);
    M5.Lcd.setCursor(bar_x, bar1_y + BAR_H + 5);
    M5.Lcd.print("---");

    // Panel 2: Weekly
    drawPanel(PANEL_X, PANEL2_Y, PANEL_W, PANEL_H);

    M5.Lcd.setTextSize(3);
    M5.Lcd.setTextColor(COL_TEXT, COL_PANEL);
    M5.Lcd.setCursor(PANEL_X + PANEL_PAD, PANEL2_Y + PANEL_PAD);
    M5.Lcd.print("---%");

    drawPill(PANEL_X + PANEL_W - 60, PANEL2_Y + PANEL_PAD + 2, "Weekly");

    int bar2_y = PANEL2_Y + 38;
    drawBar(bar_x, bar2_y, bar_w, BAR_H, 0, COL_GREEN);

    M5.Lcd.setTextSize(1);
    M5.Lcd.setTextColor(COL_DIM, COL_PANEL);
    M5.Lcd.setCursor(bar_x, bar2_y + BAR_H + 5);
    M5.Lcd.print("---");

    // Bottom button labels
    M5.Lcd.setTextSize(1);
    M5.Lcd.setTextColor(COL_DIM, COL_BG);
    M5.Lcd.setCursor(10, 228);
    M5.Lcd.print("SPLASH");
    M5.Lcd.setCursor(280, 228);
    M5.Lcd.print("EXIT");

    if (usage_data.ok) drawUsageBars();
    drawStatusLine();
}

void ClaudeMode::drawUsageBars() {
    int s = usage_data.session_pct;
    int w = usage_data.weekly_pct;
    int bar_x = PANEL_X + PANEL_PAD;
    int bar_w = PANEL_W - 2 * PANEL_PAD;

    // Session panel
    M5.Lcd.setTextSize(3);
    M5.Lcd.setTextColor(COL_TEXT, COL_PANEL);
    M5.Lcd.setCursor(PANEL_X + PANEL_PAD, PANEL1_Y + PANEL_PAD);
    M5.Lcd.printf("%d%%  ", s);

    int bar1_y = PANEL1_Y + 38;
    drawBar(bar_x, bar1_y, bar_w, BAR_H, s, pct_color(s));
    drawResetTime(bar_x, bar1_y + BAR_H + 5, usage_data.session_reset_min);

    // Weekly panel
    M5.Lcd.setTextSize(3);
    M5.Lcd.setTextColor(COL_TEXT, COL_PANEL);
    M5.Lcd.setCursor(PANEL_X + PANEL_PAD, PANEL2_Y + PANEL_PAD);
    M5.Lcd.printf("%d%%  ", w);

    int bar2_y = PANEL2_Y + 38;
    drawBar(bar_x, bar2_y, bar_w, BAR_H, w, pct_color(w));
    drawResetTime(bar_x, bar2_y + BAR_H + 5, usage_data.weekly_reset_min);
}

void ClaudeMode::drawStatusLine() {
    static bool last_ok = false;
    static bool last_connected = false;
    static uint32_t last_draw = 0;

    bool changed = (usage_data.ok != last_ok) || (ble_connected != last_connected);
    if (!changed && millis() - last_draw < 1000) return;
    last_ok = usage_data.ok;
    last_connected = ble_connected;
    last_draw = millis();

    M5.Lcd.fillRect(0, 205, 270, 16, COL_BG);
    M5.Lcd.setTextSize(1);
    M5.Lcd.setCursor(MARGIN, 208);

    if (usage_data.ok) {
        M5.Lcd.setTextColor(COL_GREEN, COL_BG);
        M5.Lcd.printf("Connected [%s]", usage_data.status);
    } else if (ble_connected) {
        M5.Lcd.setTextColor(COL_GREEN, COL_BG);
        M5.Lcd.print("Connected, awaiting data...");
    } else {
        M5.Lcd.setTextColor(COL_AMBER, COL_BG);
        M5.Lcd.print("Waiting for connection...");
    }
}

void ClaudeMode::handleCommunication(MyPalletizerBasic &myCobot) {
    if (Serial.available() > 0) {
        while (Serial.available()) Serial2.write(Serial.read());
    }
    if (Serial2.available() > 0) {
        while (Serial2.available()) Serial.write(Serial2.read());
    }
}
